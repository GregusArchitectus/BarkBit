## fw/barkbit-nrfsdk/boards/arm/barkbit/Kconfig.board
```kconfig
# BarkBit board configuration

# Copyright (c) 2020 Greg Lincoln
# SPDX-License-Identifier: Apache-2.0

config BOARD_BARKBIT_NRF52832
	bool "BarkBit"
	depends on SOC_NRF52832_QFAA
```

## fw/barkbit-nrfsdk/boards/arm/barkbit/Kconfig.defconfig
```kconfig
# BarkBit board configuration

# Copyright (c) 2020 Greg Lincoln
# SPDX-License-Identifier: Apache-2.0

if BOARD_BARKBIT_NRF52832

config BOARD
	default "barkbit_nrf52832"

config BT_CTLR
	default BT

endif # BOARD_BARKBIT_NRF52832
```

## fw/barkbit-nrfsdk/boards/arm/barkbit/barkbit_nrf52832_defconfig
```kconfig
# SPDX-License-Identifier: Apache-2.0

CONFIG_SOC_SERIES_NRF52X=y
CONFIG_SOC_NRF52832_QFAA=y
CONFIG_BOARD_BARKBIT_NRF52832=y

CONFIG_ARM_MPU=y

CONFIG_USE_SEGGER_RTT=y
CONFIG_GPIO=y

CONFIG_PRINTK=y
CONFIG_SERIAL=y

CONFIG_UART_RTT=y
CONFIG_UART_RTT_1=y

CONFIG_CONSOLE=y
CONFIG_RTT_CONSOLE=y
CONFIG_UART_CONSOLE=n

# additional board options
#CONFIG_GPIO_AS_PINRESET=y
```
